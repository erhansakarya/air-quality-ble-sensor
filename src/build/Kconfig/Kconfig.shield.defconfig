## src/build/Kconfig/Kconfig.shield.defconfig
```kconfig
osource "C:/Users/LENOVO/github/air-quality-ble-sensor/src/boards/shields/*/Kconfig.defconfig"
osource "C:/ncs/v3.0.2/nrf/boards/shields/*/Kconfig.defconfig"
```
